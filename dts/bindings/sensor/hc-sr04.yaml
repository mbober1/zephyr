## dts/bindings/sensor/hc-sr04.yaml
```yaml
# Copyright (c) 2024, Adrien Leravat
# SPDX-License-Identifier: Apache-2.0

description: HC-SR04 ultrasound sensor.

compatible: "hc-sr04"

include: sensor-device.yaml

properties:
  pwms:
    required: true
    type: phandle-array
    description: Reference to a PWM instance.
```
